// Wiring code generated from an ArduinoML model
// Application name: StateBasedAlarm!

long debounce = 200;

enum STATE {on, off};
STATE currentState = off;

boolean buttonBounceGuard = false;
long buttonLastDebounceTime = 0;

void setup(){
  pinMode(8, INPUT);  // button [Sensor]
  pinMode(12, OUTPUT); // led [Actuator]
}

void loop() {
	switch(currentState){
		case on:
			digitalWrite(12,HIGH);
			if( (digitalRead(8) == HIGH && buttonBounceGuard) ) {
				currentState = off;
			}
		break;
		case off:
			digitalWrite(12,LOW);
			if( (digitalRead(8) == HIGH && buttonBounceGuard) ) {
				currentState = on;
			}
		break;
	}
}
