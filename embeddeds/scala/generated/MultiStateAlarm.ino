// Wiring code generated from an ArduinoML model
// Application name: MultiStateAlarm!

long debounce = 200;

enum STATE {off, buzzing, ledOn};
STATE currentState = off;

boolean buttonBounceGuard = false;
long buttonLastDebounceTime = 0;

void setup(){
  pinMode(8, INPUT);  // button [Sensor]
  pinMode(12, OUTPUT); // led [Actuator]
  pinMode(11, OUTPUT); // buzzer [Actuator]
}

void loop() {
	switch(currentState){
		case off:
			digitalWrite(12,LOW);
			digitalWrite(11,LOW);
			if( (digitalRead(8) == HIGH && buttonBounceGuard) ) {
				currentState = buzzing;
			}
		break;
		case buzzing:
			digitalWrite(11,HIGH);
			digitalWrite(12,LOW);
			if( (digitalRead(8) == HIGH && buttonBounceGuard) ) {
				currentState = ledOn;
			}
		break;
		case ledOn:
			digitalWrite(12,HIGH);
			digitalWrite(11,LOW);
			if( (digitalRead(8) == HIGH && buttonBounceGuard) ) {
				currentState = off;
			}
		break;
	}
}
